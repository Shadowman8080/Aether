## build/aether-external/package/aether-vmtools/Config.in
```kconfig
config BR2_PACKAGE_AETHER_VMTOOLS
	bool "Aether open-vm-tools"
	depends on BR2_i386 || BR2_x86_64 || BR2_aarch64
	depends on BR2_USE_MMU && BR2_USE_WCHAR && BR2_TOOLCHAIN_HAS_THREADS
	depends on BR2_ENABLE_LOCALE && !BR2_STATIC_LIBS
	select BR2_PACKAGE_LIBGLIB2
	select BR2_PACKAGE_LIBTIRPC
	select BR2_PACKAGE_LIBXCRYPT if BR2_TOOLCHAIN_USES_GLIBC
	select BR2_PACKAGE_LIBFUSE3
	help
	  Source-built VMware guest service and shared-folder FUSE helper.
	  Desktop clipboard integration requires the later graphical image.
```

## build/configs/aether_arm64_defconfig
```kconfig
BR2_aarch64=y
BR2_cortex_a53=y
BR2_TOOLCHAIN_BUILDROOT_GLIBC=y
BR2_TOOLCHAIN_BUILDROOT_CXX=y
BR2_TOOLCHAIN_BUILDROOT_VENDOR="aether"
BR2_GCC_VERSION_15_X=y
BR2_PACKAGE_HOST_LINUX_HEADERS_CUSTOM_6_18=y
BR2_GLOBAL_PATCH_DIR="board/qemu/patches"
BR2_DOWNLOAD_FORCE_CHECK_HASHES=y
BR2_REPRODUCIBLE=y
BR2_TARGET_GENERIC_HOSTNAME="aether"
BR2_TARGET_GENERIC_ISSUE="Aether Linux 0.1-dev - source-built ARM64 prototype"
BR2_INIT_BUSYBOX=y
BR2_ROOTFS_DEVICE_CREATION_DYNAMIC_DEVTMPFS=y
BR2_TARGET_GENERIC_GETTY_PORT="tty1"
BR2_SYSTEM_BIN_SH_BASH=y
BR2_PACKAGE_BUSYBOX_SHOW_OTHERS=y
BR2_PACKAGE_BASH=y
BR2_PACKAGE_COREUTILS=y
BR2_ROOTFS_OVERLAY="/opt/aether/overlay-arm64"
BR2_ROOTFS_POST_BUILD_SCRIPT="/opt/aether/scripts/post-build-arm64.sh"
BR2_LINUX_KERNEL=y
BR2_LINUX_KERNEL_CUSTOM_VERSION=y
BR2_LINUX_KERNEL_CUSTOM_VERSION_VALUE="6.18.7"
BR2_LINUX_KERNEL_USE_CUSTOM_CONFIG=y
BR2_LINUX_KERNEL_CUSTOM_CONFIG_FILE="/opt/aether/configs/linux-arm64.config"
BR2_LINUX_KERNEL_NEEDS_HOST_LIBELF=y
BR2_TARGET_ROOTFS_CPIO=y
BR2_TARGET_ROOTFS_CPIO_GZIP=y
BR2_TARGET_ROOTFS_TAR=y
BR2_TARGET_GRUB2=y
BR2_TARGET_GRUB2_ARM64_EFI=y
BR2_TARGET_GRUB2_BUILTIN_MODULES_EFI="boot linux normal configfile iso9660 fat part_gpt part_msdos search search_fs_file serial terminal echo test efi_gop"
BR2_TARGET_GRUB2_BUILTIN_CONFIG_EFI="/opt/aether/configs/grub-early.cfg"
BR2_LINUX_KERNEL_NEEDS_HOST_OPENSSL=y
```
